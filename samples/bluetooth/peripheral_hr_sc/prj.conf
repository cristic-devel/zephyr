## CMakeLists.txt
```
# SPDX-License-Identifier: Apache-2.0

cmake_minimum_required(VERSION 3.13.1)

include($ENV{ZEPHYR_BASE}/cmake/app/boilerplate.cmake NO_POLICY_SCOPE)
project(peripheral_hr_sc)

FILE(GLOB app_sources src/*.c)
target_sources(app PRIVATE
  ${app_sources}
  )

zephyr_library_include_directories($ENV{ZEPHYR_BASE}/samples/bluetooth)
```

## sample.yaml
```
sample:
  description: TBD
  name: TBD
tests:
  sample.bluetooth.peripheral_hr_sc:
    harness: bluetooth
    platform_whitelist: qemu_cortex_m3 qemu_x86
    tags: bluetooth
  sample.bluetooth.peripheral_hr_rv32m1_vega_ri5cy:
    platform_whitelist: rv32m1_vega_ri5cy
    tags: bluetooth
    build_only: true
  sample.bluetooth.peripheral_hr.frdm_kw41z_shield:
    harness: bluetooth
    platform_whitelist: mimxrt1020_evk mimxrt1050_evk mimxrt1060_evk frdm_k64f
    tags: bluetooth
    extra_args: SHIELD=frdm_kw41z
```

## prj.conf
```kconfig
CONFIG_BT=y
CONFIG_BT_DEBUG_LOG=y
CONFIG_BT_PERIPHERAL=y
CONFIG_BT_SMP=y
CONFIG_BT_SMP_SC_ONLY=y
CONFIG_BT_TINYCRYPT_ECC=y
CONFIG_BT_GATT_DIS=y
CONFIG_BT_GATT_DIS_PNP=n
CONFIG_BT_GATT_BAS=y
CONFIG_BT_GATT_HRS=y
CONFIG_BT_DEVICE_NAME="Zephyr Heartrate Secured Sensor"
CONFIG_BT_DEVICE_APPEARANCE=833
```

## src/main.c
```c
/* main.c - Application main entry point */

/*
 * Copyright (c) 2015-2016 Intel Corporation
 *
 * SPDX-License-Identifier: Apache-2.0
 */

#include <zephyr/types.h>
#include <stddef.h>
#include <string.h>
#include <errno.h>
#include <sys/printk.h>
#include <sys/byteorder.h>
#include <zephyr.h>

#include <bluetooth/bluetooth.h>
#include <bluetooth/hci.h>
#include <bluetooth/conn.h>
#include <bluetooth/uuid.h>
#include <bluetooth/gatt.h>
#include <bluetooth/services/bas.h>
#include <bluetooth/services/hrs.h>

struct bt_conn *default_conn;

static const struct bt_data ad[] = {
	BT_DATA_BYTES(BT_DATA_FLAGS, (BT_LE_AD_GENERAL | BT_LE_AD_NO_BREDR)),
	BT_DATA_BYTES(BT_DATA_UUID16_ALL, 0x0d, 0x18, 0x0f, 0x18, 0x05, 0x18),
};

extern int encr_pkts;
extern int packet_log_idx;
#define PACKET_LOG_SIZE 900
extern struct {
	u32_t tmr;
	u8_t code;
	u8_t chan;
	u8_t hdr;
	u8_t len;
	u8_t rx;
} packet_log[PACKET_LOG_SIZE];

static void connected(struct bt_conn *conn, u8_t err)
{
	char addr[BT_ADDR_LE_STR_LEN];

	bt_addr_le_to_str(bt_conn_get_dst(conn), addr, sizeof(addr));

	if (err) {
		printk("Failed to connect to %s (%u)\n", addr, err);
	} else {
		default_conn = bt_conn_ref(conn);
		printk("Connected\n");

		if (bt_conn_set_security(conn, BT_SECURITY_L4)) {
			printk("Failed to set security\n");
		}
	}
}

static void disconnected(struct bt_conn *conn, u8_t reason)
{
	int i;
	printk("Disconnected (reason 0x%02x)\n", reason);
	printk("encr pkts = %d log %d\n", encr_pkts, packet_log_idx);
	printk("time:Rx:chan:hdr:len:code\n");
	for (i = 0; i < packet_log_idx;) {
		printk("%u:%c:%d:%d:%d:%d-",
				packet_log[i].tmr, packet_log[i].rx ? 'R' : 'T',
				packet_log[i].chan, packet_log[i].hdr,
				packet_log[i].len, packet_log[i].code);
		i++;
		printk("%u:%c:%d:%d:%d:%d-",
				packet_log[i].tmr, packet_log[i].rx ? 'R' : 'T',
				packet_log[i].chan, packet_log[i].hdr,
				packet_log[i].len, packet_log[i].code);
		i++;
		printk("%u:%c:%d:%d:%d:%d-",
				packet_log[i].tmr, packet_log[i].rx ? 'R' : 'T',
				packet_log[i].chan, packet_log[i].hdr,
				packet_log[i].len, packet_log[i].code);
		i++;
		printk("%u:%c:%d:%d:%d:%d-",
				packet_log[i].tmr, packet_log[i].rx ? 'R' : 'T',
				packet_log[i].chan, packet_log[i].hdr,
				packet_log[i].len, packet_log[i].code);
		i++;
		printk("%u:%c:%d:%d:%d:%d\n",
				packet_log[i].tmr, packet_log[i].rx ? 'R' : 'T',
				packet_log[i].chan, packet_log[i].hdr,
				packet_log[i].len, packet_log[i].code);
		i++;
	}

	if (default_conn) {
		bt_conn_unref(default_conn);
		default_conn = NULL;
	}
	encr_pkts = 0;
}

static void security_changed(struct bt_conn *conn, bt_security_t level,
			     enum bt_security_err err)
{
	char addr[BT_ADDR_LE_STR_LEN];

	bt_addr_le_to_str(bt_conn_get_dst(conn), addr, sizeof(addr));

	if (!err) {
		printk("Security changed: %s level %u\n", addr, level);
	} else {
		printk("Security failed: %s level %u err %d\n", addr, level,
		       err);
	}
}

static struct bt_conn_cb conn_callbacks = {
	.connected = connected,
	.disconnected = disconnected,
	.security_changed = security_changed,
};

static void bt_ready(int err)
{
	if (err) {
		printk("Bluetooth init failed (err %d)\n", err);
		return;
	}

	printk("Bluetooth initialized\n");

	err = bt_le_adv_start(BT_LE_ADV_CONN_NAME, ad, ARRAY_SIZE(ad), NULL, 0);
	if (err) {
		printk("Advertising failed to start (err %d)\n", err);
		return;
	}

	printk("Advertising successfully started\n");
}

static void auth_passkey_display(struct bt_conn *conn, unsigned int passkey)
{
	char addr[BT_ADDR_LE_STR_LEN];

	bt_addr_le_to_str(bt_conn_get_dst(conn), addr, sizeof(addr));

	printk("Passkey for %s: %06u\n", addr, passkey);
}

static void auth_cancel(struct bt_conn *conn)
{
	char addr[BT_ADDR_LE_STR_LEN];

	bt_addr_le_to_str(bt_conn_get_dst(conn), addr, sizeof(addr));

	printk("Pairing cancelled: %s\n", addr);
}

#define RISCV_WRITE_CYCLES(cycles) \
	__asm__ volatile ("csrw 0x780, %0" :      : "r" (cycles))

static void pairing_complete(struct bt_conn *conn, bool bonded)
{
	printk("Pairing Complete\n");
	packet_log_idx = 0;
	RISCV_WRITE_CYCLES(0);
}

static void pairing_failed(struct bt_conn *conn, enum bt_security_err reason)
{
	printk("Pairing Failed (%d). Disconnecting.\n", reason);
	bt_conn_disconnect(conn, BT_HCI_ERR_AUTH_FAIL);
}

static struct bt_conn_auth_cb auth_cb_display = {
	.passkey_display = auth_passkey_display,
	.passkey_entry = NULL,
	.cancel = auth_cancel,
	.pairing_complete = pairing_complete,
	.pairing_failed = pairing_failed,
};

static void bas_notify(void)
{
	u8_t battery_level = bt_gatt_bas_get_battery_level();

	battery_level--;

	if (!battery_level) {
		battery_level = 100U;
	}

	bt_gatt_bas_set_battery_level(battery_level);
}

static void hrs_notify(void)
{
	static u8_t heartrate = 90U;

	/* Heartrate measurements simulation */
	heartrate++;
	if (heartrate == 160U) {
		heartrate = 90U;
	}

	bt_gatt_hrs_notify(heartrate);
}

void main(void)
{
	int err;

	err = bt_enable(bt_ready);
	if (err) {
		printk("Bluetooth init failed (err %d)\n", err);
		return;
	}

	bt_conn_cb_register(&conn_callbacks);
	bt_conn_auth_cb_register(&auth_cb_display);

	/* Implement notification. At the moment there is no suitable way
	 * of starting delayed work so we do it here
	 */
	while (1) {
		k_sleep(MSEC_PER_SEC);

		if (default_conn == NULL) {
			continue;
		}

		/* Heartrate measurements simulation */
		hrs_notify();

		/* Battery level simulation */
		bas_notify();
	}
}
```
